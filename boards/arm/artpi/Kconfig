## boards/arm/artpi/Kconfig.board
```kconfig
# ART-Pi board configuration

# SPDX-License-Identifier: Apache-2.0

config BOARD_ARTPI
	bool "ART-Pi Development Board"
	depends on SOC_STM32H750XX
```

## boards/arm/artpi/Kconfig.defconfig
```kconfig
# SPDX-License-Identifier: Apache-2.0

if BOARD_ARTPI

config BOARD
	default "artpi"

config SPI_STM32_INTERRUPT
	default y
	depends on SPI

endif # BOARD_ARTPI
```

## boards/arm/artpi/artpi_defconfig
```kconfig
# SPDX-License-Identifier: Apache-2.0

CONFIG_SOC_SERIES_STM32H7X=y
CONFIG_SOC_STM32H750XX=y

# Memory
CONFIG_HEAP_MEM_POOL_SIZE=20480

# MEMC
CONFIG_MEMC=y
CONFIG_MEMC_STM32_SDRAM=y

# Enable MPU
CONFIG_ARM_MPU=y

# Enable HW stack protection
CONFIG_HW_STACK_PROTECTION=y

# Enable UART
CONFIG_SERIAL=y

# Enable GPIO
CONFIG_GPIO=y

# Enable Clocks
CONFIG_CLOCK_CONTROL=y

# Enable Pin controller
CONFIG_PINCTRL=y

# Enable USB Device
CONFIG_USB_DEVICE_STACK=y
CONFIG_USB_DEVICE_PRODUCT="ART-Pi Console"

# Flash QSPI
CONFIG_FLASH_SIZE=8192
CONFIG_FLASH_BASE_ADDRESS=0x90000000
```
