/*
 * SPDX-License-Identifier: Apache-2.0
 */

/dts-v1/;
#include "artpi.dtsi"

/ {
    chosen {
		zephyr,console = &cdc_acm_uart0;
	};
};

&zephyr_udc0 {
	status = "okay";
	cdc_acm_uart0: cdc_acm_uart0 {
		compatible = "zephyr,cdc-acm-uart";
	};
};
